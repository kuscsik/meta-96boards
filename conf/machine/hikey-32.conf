## conf/machine/hikey-32.conf
```bitbake
#@TYPE: Machine
#@NAME: LeMaker HiKey machine
#@DESCRIPTION: LeMaker HiKey machine

require conf/machine/include/tune-cortexa8.inc

PREFERRED_PROVIDER_virtual/xserver ?= "xserver-xorg"

XSERVER ?= "xserver-xorg \
            mesa-driver-swrast \
            xf86-input-evdev \
            xf86-input-mouse \
            xf86-video-fbdev \
            xf86-input-keyboard"

MACHINE_FEATURES = "usbhost usbgadget alsa screen wifi bluetooth ext2 efi mali450"


KERNEL_IMAGETYPE = "Image"
KERNEL_DEVICETREE = "hisilicon/hi6220-hikey.dtb"

SERIAL_CONSOLE = "115200 ttyAMA3"

CMDLINE_ROOT_EMMC   = "mmcblk0p9"
CMDLINE_ROOT_SDCARD = "mmcblk1p2"
CMDLINE ?= "console=ttyAMA3,115200n8 root=/dev/${CMDLINE_ROOT_EMMC} rootwait ro quiet efi=noruntime"

# Fastboot expects an ext4 image, which needs to be 4096 bytes aligned
IMAGE_FSTYPES_append = " ext4.gz"
IMAGE_ROOTFS_ALIGNMENT = "4096"
EXTRA_IMAGECMD_ext4 += " -L rootfs "


# Don't include kernels in this image.
# The 32bit hikey image only works with 64bit Kernel.
# which is build using the helper command
# bitbake_with_extra_minimal_image --extra-machine hikey rpb-weston-image

RDEPENDS_kernel-base = ""

# Use a common kernel recipe for all QEMU machines
PREFERRED_PROVIDER_virtual/kernel ?= "linux-dummy"

KERNEL_IMAGETYPE = "zImage"
```
